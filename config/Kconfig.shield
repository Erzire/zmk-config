## config/Kconfig.shield
```kconfig
# Copyright (c) 2022 The ZMK Contributors
# SPDX-License-Identifier: MIT

config SHIELD_SOFLE_LEFT
	def_bool $(shields_list_contains,sofle_rgb_keyhive_left)

config SHIELD_SOFLE_RIGHT
	def_bool $(shields_list_contains,sofle_rgb_keyhive_right)
```
